## experiments/esp_idf_ecg_migration/components/esp-nn/test_app/sdkconfig.defaults.esp32s31
```kconfig
#
# ESP System Settings
#
CONFIG_ESP_DEFAULT_CPU_FREQ_MHZ=320
CONFIG_ESP_DEFAULT_CPU_FREQ_MHZ_320=y

#
# esp-nn
#
CONFIG_NN_OPTIMIZED=y
```

## experiments/esp_tflm_bench/sdkconfig.defaults
```kconfig
CONFIG_FREERTOS_HZ=1000
CONFIG_ESP_DEFAULT_CPU_FREQ_MHZ_240=y
CONFIG_ESP32S3_SPIRAM_SUPPORT=y
```
